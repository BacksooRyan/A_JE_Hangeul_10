// Generated by extras/design-font.mjs. Bit 13 is the left dot.
static const uint16_t initials[][14] PROGMEM = {
  { 0x0000, 0x0000, 0x3fc0, 0x0040, 0x0040, 0x0040, 0x0040, 0x0040, 0x0040, 0x0040, 0x0040, 0x0080, 0x0000, 0x0000 }, // ㄱ 1
  { 0x0ff8, 0x0008, 0x0008, 0x0008, 0x0008, 0x0008, 0x0010, 0x0000, 0x0000, 0x0000, 0x0000, 0x0000, 0x0000, 0x0000 }, // ㄱ 2
  { 0x3fc0, 0x0040, 0x0040, 0x0040, 0x0040, 0x0040, 0x0080, 0x0000, 0x0000, 0x0000, 0x0000, 0x0000, 0x0000, 0x0000 }, // ㄱ 3
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  { 0x0600, 0x3fc0, 0x0600, 0x0900, 0x0600, 0x0000, 0x0000, 0x0000, 0x0000, 0x0000, 0x0000, 0x0000, 0x0000, 0x0000 }, // ㅎ 6
};

static const uint16_t vowels[][14] PROGMEM = {
  { 0x0008, 0x0008, 0x0008, 0x0008, 0x0008, 0x0008, 0x000e, 0x0008, 0x0008, 0x0008, 0x0008, 0x0008, 0x0008, 0x0008 }, // ㅏ 1
  { 0x0008, 0x0008, 0x0008, 0x0008, 0x000e, 0x0008, 0x0008, 0x0008, 0x0000, 0x0000, 0x0000, 0x0000, 0x0000, 0x0000 }, // ㅏ 2
  { 0x0008, 0x0008, 0x0008, 0x0008, 0x000e, 0x0008, 0x0008, 0x0008, 0x0008, 0x0008, 0x0008, 0x0008, 0x0000, 0x0000 }, // ㅏ 3
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  { 0x0004, 0x0004, 0x0004, 0x0004, 0x0004, 0x0004, 0x0004, 0x0004, 0x0004, 0x0004, 0x0004, 0x0004, 0x0000, 0x0000 }, // ㅣ 3
};

static const uint16_t finals[][14] PROGMEM = {
  { 0x0000, 0x0000, 0x0000, 0x0000, 0x0000, 0x0000, 0x0000, 0x0000, 0x0000, 0x0ff8, 0x0008, 0x0008, 0x0008, 0x0008 }, // ㄱ 1
  { 0x0000, 0x0000, 0x0000, 0x0000, 0x0000, 0x0000, 0x0000, 0x0000, 0x0000, 0x1f3e, 0x0102, 0x0102, 0x0102, 0x0102 }, // ㄲ 1
  { 0x0000, 0x0000, 0x0000, 0x0000, 0x0000, 0x0000, 0x0000, 0x0000, 0x0000, 0x1f08, 0x0114, 0x0114, 0x0122, 0x0122 }, // ㄳ 1
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  { 0x0000, 0x0000, 0x0000, 0x0000, 0x0000, 0x0000, 0x0000, 0x0000, 0x0000, 0x00c0, 0x0ff8, 0x01c0, 0x0220, 0x01c0 }, // ㅎ 1
};
