// Generated by extras/design-font.mjs. Bit 15 is the left dot.
static const uint16_t initials[][16] PROGMEM = {
  { 0x0000, 0x0000, 0x7f80, 0x0080, 0x0080, 0x0080, 0x0080, 0x0080, 0x0080, 0x0080, 0x0080, 0x0080, 0x0100, 0x0000, 0x0000, 0x0000 }, // ㄱ 1
  { 0x3ff8, 0x0008, 0x0008, 0x0008, 0x0008, 0x0008, 0x0008, 0x0010, 0x0000, 0x0000, 0x0000, 0x0000, 0x0000, 0x0000, 0x0000, 0x0000 }, // ㄱ 2
  { 0xff80, 0x0080, 0x0080, 0x0080, 0x0080, 0x0080, 0x0080, 0x0100, 0x0000, 0x0000, 0x0000, 0x0000, 0x0000, 0x0000, 0x0000, 0x0000 }, // ㄱ 3
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  { 0x0c00, 0xff80, 0x0000, 0x1c00, 0x2200, 0x1c00, 0x0000, 0x0000, 0x0000, 0x0000, 0x0000, 0x0000, 0x0000, 0x0000, 0x0000, 0x0000 }, // ㅎ 6
};

static const uint16_t vowels[][16] PROGMEM = {
  { 0x0008, 0x0008, 0x0008, 0x0008, 0x0008, 0x0008, 0x0008, 0x000e, 0x0008, 0x0008, 0x0008, 0x0008, 0x0008, 0x0008, 0x0008, 0x0008 }, // ㅏ 1
  { 0x0008, 0x0008, 0x0008, 0x0008, 0x000e, 0x0008, 0x0008, 0x0008, 0x0008, 0x0000, 0x0000, 0x0000, 0x0000, 0x0000, 0x0000, 0x0000 }, // ㅏ 2
  { 0x0008, 0x0008, 0x0008, 0x0008, 0x000e, 0x0008, 0x0008, 0x0008, 0x0008, 0x0008, 0x0008, 0x0008, 0x0008, 0x0008, 0x0000, 0x0000 }, // ㅏ 3
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  { 0x0004, 0x0004, 0x0004, 0x0004, 0x0004, 0x0004, 0x0004, 0x0004, 0x0004, 0x0004, 0x0004, 0x0004, 0x0004, 0x0004, 0x0000, 0x0000 }, // ㅣ 3
};

static const uint16_t finals[][16] PROGMEM = {
  { 0x0000, 0x0000, 0x0000, 0x0000, 0x0000, 0x0000, 0x0000, 0x0000, 0x0000, 0x0000, 0x1ff0, 0x0010, 0x0010, 0x0010, 0x0010, 0x0010 }, // ㄱ 1
  { 0x0000, 0x0000, 0x0000, 0x0000, 0x0000, 0x0000, 0x0000, 0x0000, 0x0000, 0x0000, 0x7e7c, 0x0204, 0x0204, 0x0204, 0x0204, 0x0204 }, // ㄲ 1
  { 0x0000, 0x0000, 0x0000, 0x0000, 0x0000, 0x0000, 0x0000, 0x0000, 0x0000, 0x0000, 0x7e10, 0x0210, 0x0228, 0x0228, 0x0244, 0x0244 }, // ㄳ 1
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  { 0x0000, 0x0000, 0x0000, 0x0000, 0x0000, 0x0000, 0x0000, 0x0000, 0x0000, 0x0000, 0x0180, 0x1ff0, 0x0000, 0x0380, 0x0440, 0x0380 }, // ㅎ 1
};
